// Energymetering your home and solar with Blynk
// using an HIKING DDS238-2 ZN/S energy meter for the mains and a EPEVER TRACER AN-Series charge controller for your solar
// read-out with ESP8266 by Modbus over RS-485
//
// Wiring RS485 UART Module (with automatic flow control 74HC04) to ESP8266
// VCC (Module) - VIN (5V - ESP8266)
// TX (Module) - TX0 (D1 - GPIO1 - ESP8266)
// RX (Module) - RX0 (D3 - GPIO3 - ESP8266)
// GND (Module) - GND (G - GND - ESP8266)
//
// Wiring RS485 UART Module to HIKING DDS238 & EPEVER TRACER
// A+ => Clamp 8 (RS485A) & RJ45 Pin 5+6 (A+)
// B- => Clamp 7 (RS485B) & RJ45 Pin 3+4 (B-)
// GND => n.c. & RJ45 Pin 7+8 (GND)
//
// Wiring TTL-to-RS232-Converter (for output of debug console) to ESP8266
// RX (Converter) - TX1 (D4 - GPIO4 - ESP8266)
// GND (Converter) - GND (G - GND - ESP8266)
//
// During first upload of code through USB you might disconnect RX of RS485 UART Module to not interfere
// After that you should be able to update over WiFi (ArduinoOTA)
//
// Tested on NodeMCU + RS485 UART Module (with automatic flow control 74HC04)
// Developed by @jaminNZx with modifications by @tekk and @AndreasIBZ

#include <ESP8266WiFi.h>
#include <ArduinoOTA.h>
#include <BlynkSimpleEsp8266.h>
#include <ModbusMaster.h>
#include "settings.h"

#define ARRAY_SIZE(A) (sizeof(A) / sizeof((A)[0]))

uint16_t SerialBaudrate = 57600;					// Baudrate Serial Monitor via TTL-to-RS232-Converter
uint32_t HIKING_DDS238_Baudrate = 9600;				// Baudrate HIKING DDS238
uint32_t EPEVER_TRACER_Baudrate = 115200;			// Baudrate EPEVER TRACER
uint8_t HIKING_DDS238_SlaveID = 2;					// you have to change the default SlaveID "1" to "2"
uint8_t EPEVER_TRACER_SlaveID = 1;
float OFFSET_TRACER_ENERGY_CONS_TOTAL = -0.00;     // correction of total energy consumed by load on TRACER
float OFFSET_DDS238_currenttotalenergy = -0.00;     // correction of total energy consumed from mains on DDS238
float OFFSET_TRACER_ENERGY_GEN_TOTAL = -0.00;       // correction of total energy generated by PV on TRACER

int timerTask1, timerTask2, timerTask3;
float currenttotalenergy, currentexportenergy, currentimportenergy;
float voltage, current, powerfactor, frequency;
float consEnergyToday, consEnergyMonth, consEnergyYear, consEnergyTot, genEnergyTot, redCO2;
int16_t activepower, reactivepower;
float battChargeCurrent, battDischargeCurrent, battOverallCurrent, battChargePower;
float bvoltage, ctemp, btemp, bremaining, lpower, lcurrent, pvvoltage, pvcurrent, pvpower;
float stats_today_pv_volt_min, stats_today_pv_volt_max;
uint8_t result;
bool rs485DataReceived = true;
bool loadPoweredOn = true;

ModbusMaster node;
SimpleTimer timer;

}

void ModbusDDS238() {
// communicate with HIKING DDS238 Energy Meter over Serial Modbus
  Serial.flush();                             // wait for last transmitted data to be sent
  Serial.begin(HIKING_DDS238_Baudrate);        // change Baudrate
  while(Serial.available()) Serial.read();    // empty  out possible garbage from input buffer
  delay(100);
  node.begin(HIKING_DDS238_SlaveID, Serial);   // communicate with HIKING DDS238 over Serial Modbus
}

void ModbusTRACER() {
// communicate with EPEVER TRACER Solar Charge Controller over Serial Modbus
  Serial.flush();                             // wait for last transmitted data to be sent
  Serial.begin(EPEVER_TRACER_Baudrate);       // change Baudrate
  while(Serial.available()) Serial.read();    // empty  out possible garbage from input buffer
  delay(100);
  node.begin(EPEVER_TRACER_SlaveID, Serial);  // communicate with EPEVER TRACER over Serial Modbus
}

// A list of the regisities to query in order
typedef void (*RegistryList[])();

RegistryList Registries = {
  TRACER_AddressRegistry_3100,
  TRACER_AddressRegistry_3106,
  TRACER_AddressRegistry_310D,
  TRACER_AddressRegistry_311A,
  TRACER_AddressRegistry_3304,
  TRACER_AddressRegistry_3312,
  TRACER_AddressRegistry_331B,
  DDS238_AddressRegistry_0000,
  DDS238_AddressRegistry_0008,
};

// keep log of where we are
uint8_t currentRegistryNumber = 0;

// function to switch to next registry
void nextRegistryNumber() {
  // better not use modulo, because after overlow it will start reading in incorrect order
  currentRegistryNumber++;
  if (currentRegistryNumber >= ARRAY_SIZE(Registries)) {
    currentRegistryNumber = 0;
  }
}

// ****************************************************************************

void setup()
{

  // use Serial initialize Modbus communication baud rate
  Serial.begin(EPEVER_TRACER_Baudrate); // init Serial communication with RS485-Module
  Serial1.begin(SerialBaudrate, SERIAL_8N1); // init Serial Monitor
  Serial1.setDebugOutput(true);
  node.begin(1, Serial);
  // callbacks to toggle DE + RE on MAX485 - not used here
  
  Serial1.println("Connecting to Wifi...");
  
  WiFi.mode(WIFI_STA);
  
#if defined(USE_LOCAL_SERVER)
  Blynk.begin(AUTH, WIFI_SSID, WIFI_PASS, SERVER, SERVER_PORT);
  Serial1.println("Blynk.begin .");
#else
  Blynk.begin(AUTH, WIFI_SSID, WIFI_PASS);
#endif

  while (WiFi.waitForConnectResult() != WL_CONNECTED) {
    Serial1.println("Connection Failed! Rebooting...");
    delay(5000);
    ESP.restart();
  }
  
  Serial1.println("Connected.");
  Serial1.print("Connecting to Blynk...");

  while (!Blynk.connect()) {
    Serial1.print(".");
    delay(100);
  }

  Serial1.println();
  Serial1.println("Connected to Blynk.");
  Serial1.println("Starting ArduinoOTA...");

// Over-The-Air Updates
  ArduinoOTA.setHostname(OTA_HOSTNAME);

  ArduinoOTA.onStart([]() {
    String type;
    if (ArduinoOTA.getCommand() == U_FLASH) {
      type = "sketch";
    } else { // U_SPIFFS
      type = "filesystem";
    }

    // NOTE: if updating SPIFFS this would be the place to unmount SPIFFS using SPIFFS.end()
    Serial1.println("Start updating " + type);
  });
  
  ArduinoOTA.onEnd([]() {
    Serial1.println("\nEnd of update");
  });
  
  ArduinoOTA.onProgress([](unsigned int progress, unsigned int total) {
    Serial1.printf("Progress: %u%%\r", (progress / (total / 100)));
  });
  
  ArduinoOTA.onError([](ota_error_t error) {
    Serial1.printf("Error[%u]: ", error);
    if (error == OTA_AUTH_ERROR) {
      Serial1.println("Auth Failed");
    } else if (error == OTA_BEGIN_ERROR) {
      Serial1.println("Begin Failed");
    } else if (error == OTA_CONNECT_ERROR) {
      Serial1.println("Connect Failed");
    } else if (error == OTA_RECEIVE_ERROR) {
      Serial1.println("Receive Failed");
    } else if (error == OTA_END_ERROR) {
      Serial1.println("End Failed");
    }
  });
  
  ArduinoOTA.begin();

  Serial1.print("ArduinoOTA running. ");
  Serial1.print("IP address: ");
  Serial1.println(WiFi.localIP());
  Serial1.println("Starting timed actions...");
  
  timerTask1 = timer.setInterval(500L, executeCurrentRegistryFunction);
  timerTask2 = timer.setInterval(500L, nextRegistryNumber);
  timerTask3 = timer.setInterval(500L, uploadToBlynk);

  Serial1.println("Setup OK!");
  Serial1.println("----------------------------");
  Serial1.println();
}

// --------------------------------------------------------------------------------
// upload values to Blynk
  void uploadToBlynk() {
    Blynk.virtualWrite(vPIN_PV_POWER,                   pvpower);
    Blynk.virtualWrite(vPIN_PV_CURRENT,                 pvcurrent);
    Blynk.virtualWrite(vPIN_PV_VOLTAGE,                 pvvoltage);
    Blynk.virtualWrite(vPIN_LOAD_CURRENT,               lcurrent);
    Blynk.virtualWrite(vPIN_LOAD_POWER,                 lpower);
    Blynk.virtualWrite(vPIN_BATT_TEMP,                  btemp);
    Blynk.virtualWrite(vPIN_BATT_VOLTAGE,               bvoltage);
    Blynk.virtualWrite(vPIN_BATT_REMAIN,                bremaining);
    Blynk.virtualWrite(vPIN_CONTROLLER_TEMP,            ctemp);
    Blynk.virtualWrite(vPIN_BATTERY_CHARGE_CURRENT,     battChargeCurrent);
    Blynk.virtualWrite(vPIN_BATTERY_CHARGE_POWER,       battChargePower);
    Blynk.virtualWrite(vPIN_BATTERY_OVERALL_CURRENT,    battOverallCurrent);
    Blynk.virtualWrite(vPIN_LOAD_ENABLED,               loadPoweredOn);
    Blynk.virtualWrite(vPIN_ENERGY_CONS_TODAY,          consEnergyToday);
    Blynk.virtualWrite(vPIN_ENERGY_CONS_MONTH,          consEnergyMonth);
    Blynk.virtualWrite(vPIN_ENERGY_CONS_YEAR,           consEnergyYear);
    Blynk.virtualWrite(vPIN_ENERGY_CONS_TOTAL,          consEnergyTot);
    Blynk.virtualWrite(vPIN_ENERGY_GEN_TOTAL,           genEnergyTot);
    Blynk.virtualWrite(vPIN_CO2_REDUCTION,              redCO2);
    Blynk.virtualWrite(vPIN_currenttotalenergy,         currenttotalenergy);
    Blynk.virtualWrite(vPIN_currentexportenergy,        currentexportenergy);
    Blynk.virtualWrite(vPIN_currentimportenergy,        currentimportenergy);
    Blynk.virtualWrite(vPIN_voltage,                    voltage);
    Blynk.virtualWrite(vPIN_current,                    current);
    Blynk.virtualWrite(vPIN_activepower,                activepower);
    Blynk.virtualWrite(vPIN_reactivepower,              reactivepower);
    Blynk.virtualWrite(vPIN_powerfactor,                powerfactor);
    Blynk.virtualWrite(vPIN_frequency,                  frequency);
  }
  
  // exec a function of registry read (cycles between different addresses)
  void executeCurrentRegistryFunction() {
    Registries[currentRegistryNumber]();
  }
  
  uint8_t setOutputLoadPower(uint8_t state) {
    Serial1.print("Writing coil 0x0006 value to: ");
    Serial1.println(state);

    delay(10);
    // Set coil at address 0x0006 (Force the load on/off)
    result = node.writeSingleCoil(0x0006, state);

    if (result == node.ku8MBSuccess) {
      node.getResponseBuffer(0x00);
      Serial1.println("Success.");
    }

    return result;
  }
  
  // callback to on/off button state changes from the Blynk app
  BLYNK_WRITE(vPIN_LOAD_ENABLED) {
    uint8_t newState = (uint8_t)param.asInt();
    
    Serial1.print("Setting load state output coil to value: ");
    Serial1.println(newState);

    result = setOutputLoadPower(newState);
    //readOutputLoadState();
    result &= checkLoadCoilState();
    
    if (result == node.ku8MBSuccess) {
      Serial1.println("Write & Read suceeded.");
    } else {
      Serial1.println("Write & Read failed.");
    }
    
    Serial1.print("Output Load state value: ");
    Serial1.println(loadPoweredOn);
    Serial1.println();
    Serial1.println("Uploading results to Blynk.");
        
    uploadToBlynk();
  }
  
  uint8_t readOutputLoadState() {
    delay(10);
    result = node.readHoldingRegisters(0x903D, 1);
    
    if (result == node.ku8MBSuccess) {
      loadPoweredOn = (node.getResponseBuffer(0x00) & 0x02) > 0;
  
      Serial1.print("Set success. Load: ");
      Serial1.println(loadPoweredOn);
    } else {
      // update of status failed
      Serial1.println("readHoldingRegisters(0x903D, 1) failed!");
    }
    return result;
  }
  
  // reads Load Enable Override coil
  uint8_t checkLoadCoilState() {
    Serial1.print("Reading coil 0x0006... ");

    delay(10);
    result = node.readCoils(0x0006, 1);
    
    Serial1.print("Result: ");
    Serial1.println(result);

    if (result == node.ku8MBSuccess) {
      loadPoweredOn = (node.getResponseBuffer(0x00) > 0);

      Serial1.print(" Value: ");
      Serial1.println(loadPoweredOn);
    } else {
      Serial1.println("Failed to read coil 0x0006!");
    }

    return result;
 }

// -----------------------------------------------------------------

  void TRACER_AddressRegistry_3100() {
    ModbusTRACER(); // change communication settings
    result = node.readInputRegisters(0x3100, 6);
  
    if (result == node.ku8MBSuccess) {
      
      pvvoltage = node.getResponseBuffer(0x00) / 100.0f;
      Serial1.print("TRACER - PV Voltage: ");
      Serial1.println(pvvoltage);
  
      pvcurrent = node.getResponseBuffer(0x01) / 100.0f;
      Serial1.print("TRACER - PV Current: ");
      Serial1.println(pvcurrent);
  
      pvpower = (node.getResponseBuffer(0x02) | node.getResponseBuffer(0x03) << 16) / 100.0f;
      Serial1.print("TRACER - PV Power: ");
      Serial1.println(pvpower);
      
      bvoltage = node.getResponseBuffer(0x04) / 100.0f;
      Serial1.print("TRACER - Battery Voltage: ");
      Serial1.println(bvoltage);
      
      battChargeCurrent = node.getResponseBuffer(0x05) / 100.0f;
      Serial1.print("TRACER - Battery Charge Current: ");
      Serial1.println(battChargeCurrent);
    } else {
      rs485DataReceived = false;
      Serial1.println("Reading TRACER register 0x3100 ... 0x3105 failed!");
    }    
  }

  void TRACER_AddressRegistry_3106() {
    ModbusTRACER(); // change communication settings
    result = node.readInputRegisters(0x3106, 2);

    if (result == node.ku8MBSuccess) {
      battChargePower = (node.getResponseBuffer(0x00) | node.getResponseBuffer(0x01) << 16)  / 100.0f;
      Serial1.print("TRACER - Battery Charge Power: ");
      Serial1.println(battChargePower);
    } else {
      rs485DataReceived = false;
      Serial1.println("Reading TRACER register 0x3106 ... 0x3107 failed!");
    }    
  }

  void TRACER_AddressRegistry_310D() {
    ModbusTRACER(); // change communication settings
    result = node.readInputRegisters(0x310D, 3);

    if (result == node.ku8MBSuccess) {
      lcurrent = node.getResponseBuffer(0x00) / 100.0f;
      Serial1.print("TRACER - Load Current: ");
      Serial1.println(lcurrent);
  
      lpower = (node.getResponseBuffer(0x01) | node.getResponseBuffer(0x02) << 16) / 100.0f;
      Serial1.print("TRACER - Load Power: ");
      Serial1.println(lpower);
    } else {
      rs485DataReceived = false;
      Serial1.println("Reading TRACER register 0x310D ... 0x310F failed!");
    }    
  } 

  void TRACER_AddressRegistry_311A() {
    ModbusTRACER(); // change communication settings
    result = node.readInputRegisters(0x311A, 2);
   
    if (result == node.ku8MBSuccess) {    
      bremaining = node.getResponseBuffer(0x00) / 1.0f;
      Serial1.print("TRACER - Battery Remaining %: ");
      Serial1.println(bremaining);
      
      btemp = node.getResponseBuffer(0x01) / 100.0f;
      Serial1.print("TRACER - Battery Temperature: ");
      Serial1.println(btemp);
    } else {
      rs485DataReceived = false;
      Serial1.println("Reading TRACER register 0x311A ... 0x311B failed!");
    }
  }

  void TRACER_AddressRegistry_3304() {
    ModbusTRACER(); // change communication settings
    result = node.readInputRegisters(0x3304, 8);
    
    if (result == node.ku8MBSuccess) {
      consEnergyToday = (node.getResponseBuffer(0x00) | node.getResponseBuffer(0x01) << 16) / 100.0f;
      consEnergyMonth = (node.getResponseBuffer(0x02) | node.getResponseBuffer(0x03) << 16) / 100.0f;
      consEnergyYear = (node.getResponseBuffer(0x04) | node.getResponseBuffer(0x05) << 16) / 100.0f;
      consEnergyTot = (node.getResponseBuffer(0x06) | node.getResponseBuffer(0x07) << 16) / 100.0f ;
      consEnergyTot += OFFSET_TRACER_ENERGY_CONS_TOTAL;
      Serial1.print("TRACER - Consumed Energy Today: ");
      Serial1.println(consEnergyToday);
      Serial1.print("TRACER - Consumed Energy Month: ");
      Serial1.println(consEnergyMonth);
      Serial1.print("TRACER - Consumed Energy Year: ");
      Serial1.println(consEnergyYear);
      Serial1.print("TRACER - Consumed Energy Total: ");
      Serial1.println(consEnergyTot);
      } else {
      rs485DataReceived = false;
      Serial1.println("Reading TRACER register 0x3304 ... 0x330B failed!");
    }
  }
  
  void TRACER_AddressRegistry_3312() {
    ModbusTRACER(); // change communication settings
    result = node.readInputRegisters(0x3312, 4);  
    if (result == node.ku8MBSuccess) {
      genEnergyTot = (node.getResponseBuffer(0x00) | node.getResponseBuffer(0x01) << 16) / 100.0f;
      genEnergyTot += OFFSET_TRACER_ENERGY_GEN_TOTAL;
      redCO2 = (node.getResponseBuffer(0x02) | node.getResponseBuffer(0x03) << 16) / 100.0f;
      Serial1.print("TRACER - Generated Energy Total: ");
      Serial1.println(genEnergyTot);
      Serial1.print("TRACER - CO2 Reduction [t]: ");
      Serial1.println(redCO2);
      } else {
      rs485DataReceived = false;
      Serial1.println("Reading TRACER register 0x3312 ... 0x331C failed!");
    }
  }
  
  
  void TRACER_AddressRegistry_331B() {
    ModbusTRACER(); // change communication settings
    result = node.readInputRegisters(0x331B, 2);
    
    if (result == node.ku8MBSuccess) {
      battOverallCurrent = (node.getResponseBuffer(0x00) | node.getResponseBuffer(0x01) << 16) / 100.0f;
      Serial1.print("TRACER - Battery Discharge Current: ");
      Serial1.println(battOverallCurrent);
    } else {
      rs485DataReceived = false;
      Serial1.println("Reading TRACER register 0x331B ... 0x331C failed!");
    }
  }

  void DDS238_AddressRegistry_0000() {
    ModbusDDS238(); // change communication settings
    result = node.readHoldingRegisters(0x0000, 2);
      if (result == node.ku8MBSuccess)
      {      
        currenttotalenergy = (node.getResponseBuffer(0x01) | node.getResponseBuffer(0x00) << 16) / 100.0f;
        currenttotalenergy += OFFSET_DDS238_currenttotalenergy;
        Serial1.print("DDS238 - Current Total Energy: ");
        Serial1.println(currenttotalenergy);
        } else {
        rs485DataReceived = false;
        Serial1.println("Reading DDS238 Register 0x0000 ... 0x0001 failed!");
        }    
  }
     
  void DDS238_AddressRegistry_0008() {
    ModbusDDS238(); // change communication settings
    result = node.readHoldingRegisters(0x0008, 10);
      if (result == node.ku8MBSuccess)
      {
        currentexportenergy = (node.getResponseBuffer(0x01) | node.getResponseBuffer(0x00) << 16) / 100.0f;
        currentimportenergy = (node.getResponseBuffer(0x03) | node.getResponseBuffer(0x02) << 16) / 100.0f;     
        voltage = node.getResponseBuffer(0x04) / 10.0f;
        current = node.getResponseBuffer(0x05) / 100.0f;
        activepower = node.getResponseBuffer(0x06);
        reactivepower = node.getResponseBuffer(0x07);
        powerfactor = node.getResponseBuffer(0x08) / 1000.0f;
        frequency = node.getResponseBuffer(0x09) / 100.f;
        Serial1.print("DDS238 - Current Export Energy: ");
        Serial1.println(currentexportenergy);
        Serial1.print("DDS238 - Current Import Energy: ");
        Serial1.println(currentimportenergy);
        Serial1.print("DDS238 - Voltage: ");
        Serial1.println(voltage);
        Serial1.print("DDS238 - Current: ");
        Serial1.println(current);
        Serial1.print("DDS238 - Active Power: ");
        Serial1.println(activepower);
        Serial1.print("DDS238 - Rective Power: ");
        Serial1.println(reactivepower);
        Serial1.print("DDS238 - Powerfactor: ");
        Serial1.println(powerfactor);
        Serial1.print("DDS238 - Frequency: ");
        Serial1.println(frequency);
        } else {
        rs485DataReceived = false;
        Serial1.println("Reading DDS238 Register 0x0008 ... 0x0011 failed!");
        }    
  }

void loop()
{
  Blynk.run();
  ArduinoOTA.handle();
  timer.run();

}
